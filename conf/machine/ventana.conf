## conf/machine/ventana.conf
```bitbake
#@TYPE: Machine
#@NAME: i.MX6Q/DL Ventana Platform
#@SOC: i.MX6Q
#@DESCRIPTION: Machine configuration for Gateworks Ventana platform

# We need to override the default before everything
MACHINEOVERRIDES = "${MACHINE}:ventana"

require conf/machine/include/imx-base.inc
require conf/machine/include/tune-cortexa9.inc

SOC_FAMILY = "mx6:mx6dl:mx6q:ventana"

KERNEL_DEVICETREE  = " \
	imx6q-gw5400-a.dtb \
	imx6q-gw51xx.dtb \
	imx6q-gw52xx.dtb \
	imx6q-gw53xx.dtb \
	imx6q-gw54xx.dtb \
	imx6q-gw551x.dtb \
	imx6q-gw552x.dtb \
	imx6dl-gw51xx.dtb \
	imx6dl-gw52xx.dtb \
	imx6dl-gw53xx.dtb \
	imx6dl-gw54xx.dtb \
	imx6dl-gw551x.dtb \
	imx6dl-gw552x.dtb \
"

# Bootloader configs:
#  set UBOOT_CONFIG to one of gw54xx|gw53xx|gw52xx|gw51xx
UBOOT_CONFIG ??= "gw54xx"
UBOOT_CONFIG[gw5400a] = "gwventanaq1gspi_config"
UBOOT_CONFIG[gw54xx]  = "gwventanaq1g_config"
UBOOT_CONFIG[gw53xx]  = "gwventanadl1g_config"
UBOOT_CONFIG[gw52xx]  = "gwventanadl_config"
UBOOT_CONFIG[gw51xx]  = "gwventanadl_config"
PREFERRED_PROVIDER_u-boot = "u-boot"

SERIAL_CONSOLE = "115200 ttymxc1"

MACHINE_FEATURES += "pci wifi bluetooth"

# Add kernel modules
MACHINE_EXTRA_RRECOMMENDS += "\
	kernel-module-sky2 \
	kernel-module-cryptodev \
	"

# Modules autoload
module_autoload_sky2 = "sky2"
module_autoload_cryptodev = "cryptodev"

# Override FS Type Creation
IMAGE_FSTYPES = "tar.bz2 multiubi"

# Build the following sizes
MULTIUBI_BUILD = "normal large"

# 2K page size ('normal' flash layout)
export MKUBIFS_ARGS_normal = "-F -m 2048 -e 124KiB -c 16248 -x zlib"
export UBINIZE_ARGS_normal = "-m 2048 -p 128KiB -s 2048"

# 4K page size ('large' flash layout)
export MKUBIFS_ARGS_large = "-F -m 4096 -e 248KiB -c 8124 -x zlib"
export UBINIZE_ARGS_large = "-m 4096 -p 256KiB -s 4096"
```
